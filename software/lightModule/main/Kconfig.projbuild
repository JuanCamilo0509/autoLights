## software/lightModule/main/Kconfig.projbuild
```kconfig
menu "Configuration"

    config BROKER_URL
        string "Broker URL"
        default "mqtt://"
        help
            URL of the broker to connect to

    config TOPIC
        string "Topic URL"
        default "/"
        help
            Topic where the esp should be focus on

    config WIFI_SSID
      string "WiFi SSID"
      default "my_default_router_name"
      help
        The name of your network

    config WIFI_PASSWORD
      string "WiFi Password"
      default "..."
      help
        Password for the WiFi network.

endmenu
```
